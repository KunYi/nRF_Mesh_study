## CMakeLists.txt
```
# SPDX-License-Identifier: Apache-2.0

cmake_minimum_required(VERSION 3.20.0)

find_package(Zephyr REQUIRED HINTS $ENV{ZEPHYR_BASE})
project(mesh_button_client)

target_include_directories(app PRIVATE
  ${CMAKE_CURRENT_SOURCE_DIR}/include
)

target_sources(app PRIVATE
  src/main.c
  src/vendor_model.c
)
```

## prj.conf
```kconfig
# Enable Bluetooth
CONFIG_BT=y
CONFIG_BT_PERIPHERAL=y
CONFIG_BT_OBSERVER=y
CONFIG_BT_BROADCASTER=y
CONFIG_BT_CTLR=y

# Enable Bluetooth Mesh
CONFIG_BT_MESH=y
CONFIG_BT_MESH_RELAY=y
CONFIG_BT_MESH_LOW_POWER=n
CONFIG_BT_MESH_PB_GATT=y
CONFIG_BT_MESH_PB_ADV=y

# Enable GATT proxy feature
CONFIG_BT_MESH_GATT_PROXY=y

# Mesh model configuration
CONFIG_BT_MESH_MODEL_GROUP_COUNT=3
CONFIG_BT_MESH_MODEL_KEY_COUNT=2
CONFIG_BT_MESH_MODEL_EXTENSIONS=y
CONFIG_BT_MESH_CDB=y

# Enable settings for storing mesh data
CONFIG_SETTINGS=y
CONFIG_BT_SETTINGS=y
CONFIG_FLASH=y
CONFIG_FLASH_MAP=y
CONFIG_NVS=y
CONFIG_SETTINGS_NVS=y

# Device Management
CONFIG_HWINFO=y
CONFIG_DK_LIBRARY=y
CONFIG_DK_LIBRARY_DYNAMIC_BUTTON_HANDLERS=y

# Enable GPIO
CONFIG_GPIO=y

# Enable logging
CONFIG_LOG=y
CONFIG_LOG_DEFAULT_LEVEL=3
CONFIG_LOG_BACKEND_RTT=y
CONFIG_LOG_BACKEND_UART=y
CONFIG_USE_SEGGER_RTT=y

# Bluetooth debug logs
# CONFIG_BT_DEBUG_LOG=y
# CONFIG_BT_DEBUG=y
```

## src/main.c
```c
#include <zephyr/kernel.h>
#include <zephyr/bluetooth/mesh.h>
#include <zephyr/drivers/gpio.h>
#include "vendor_model.h"
#include "device_config.h"

/* Device UUID */
static const uint8_t dev_uuid[16] = DEV_UUID;

/* Health Server */
static struct bt_mesh_health_srv_cb health_srv_cb = HEALTH_SRV_CB;

static struct bt_mesh_health_srv health_srv = {
    .cb = &health_srv_cb,
};

static struct bt_mesh_model_pub health_pub = HEALTH_PUB;

/* Provisioning */
static const struct bt_mesh_prov prov = {
    .uuid = dev_uuid,
};

/* Button handling */
static const struct gpio_dt_spec button = GPIO_DT_SPEC_GET(DT_ALIAS(sw0), gpios);
static struct k_work button_work;

/* Forward declaration of vendor client */
static struct bt_mesh_vendor_model_cli vendor_client;

static void button_pressed_work_handler(struct k_work *work)
{
    struct button_press press = {
        .button_index = 0,
        .button_state = 1
    };
    bt_mesh_vendor_model_cli_button_press(&vendor_client, &press);
}

/* Vendor Model handlers */
static void handle_led_status(struct bt_mesh_vendor_model_cli *cli,
                           struct bt_mesh_msg_ctx *ctx,
                           struct led_status *status)
{
    printk("LED %d is %s\n", status->led_index,
           status->led_state == LED_ON ? "on" : "off");
}

static const struct vendor_model_cli_handlers cli_handlers = {
    .led_status = handle_led_status,
};

/* Initialize the Vendor Model Client */
BT_MESH_VENDOR_MODEL_CLI_DEFINE(vendor_client, cli_handlers);

/* Element Definition */
static struct bt_mesh_model models[] = {
    BT_MESH_MODEL_CFG_SRV,
    BT_MESH_MODEL_HEALTH_SRV(&health_srv, &health_pub),
    BT_MESH_MODEL_VND_CB(BT_MESH_VENDOR_COMPANY_ID,
                      BT_MESH_VENDOR_MODEL_ID_CLI,
                      vendor_cli_op,
                      NULL,
                      &vendor_client,
                      NULL),
};

static struct bt_mesh_elem elements[] = {
    BT_MESH_ELEM(0, models, BT_MESH_MODEL_NONE),
};

static const struct bt_mesh_comp comp = {
    .cid = BT_MESH_VENDOR_COMPANY_ID,
    .elem = elements,
    .elem_count = ARRAY_SIZE(elements),
};

static void button_pressed(const struct device *dev, struct gpio_callback *cb,
                         uint32_t pins)
{
    k_work_submit(&button_work);
}

static void configure_button(void)
{
    int ret;

    if (!gpio_is_ready_dt(&button)) {
        printk("Error: button device %s is not ready\n",
               button.port->name);
        return;
    }

    ret = gpio_pin_configure_dt(&button, GPIO_INPUT);
    if (ret != 0) {
        printk("Error %d: failed to configure %s pin %d\n",
               ret, button.port->name, button.pin);
        return;
    }

    ret = gpio_pin_interrupt_configure_dt(&button,
                                        GPIO_INT_EDGE_TO_ACTIVE);
    if (ret != 0) {
        printk("Error %d: failed to configure interrupt on %s pin %d\n",
               ret, button.port->name, button.pin);
        return;
    }

    static struct gpio_callback button_cb_data;
    gpio_init_callback(&button_cb_data, button_pressed, BIT(button.pin));
    gpio_add_callback(button.port, &button_cb_data);
}

int main(void)
{
    int err;

    printk("Initializing...\n");

    k_work_init(&button_work, button_pressed_work_handler);
    configure_button();

    /* Initialize the Bluetooth Mesh Stack */
    err = bt_mesh_init(&prov, &comp);
    if (err) {
        printk("Bluetooth mesh init failed (err %d)\n", err);
        return 0;
    }

    /* Enable provisioning */
    err = bt_mesh_prov_enable(BT_MESH_PROV_ADV | BT_MESH_PROV_GATT);
    if (err) {
        printk("Failed to enable provisioning (err %d)\n", err);
        return 0;
    }

    printk("Mesh initialized\n");

    return 0;
}
```

## include/device_config.h
```c
#ifndef DEVICE_CONFIG_H
#define DEVICE_CONFIG_H

#include <zephyr/bluetooth/mesh.h>
#include "vendor_model.h"

/* Device UUID for provisioning */
#define DEV_UUID { 0xcc, 0xcc }

/* Health Server */
#define HEALTH_SRV_CB { \
    .attn_on = NULL, \
    .attn_off = NULL, \
}

#define HEALTH_PUB { \
    .msg = NULL, \
}

/* Model Operation Arrays */
extern const struct bt_mesh_model_op vendor_cli_op[];

#endif /* DEVICE_CONFIG_H */
```

## include/vendor_model.h
```c
#ifndef VENDOR_MODEL_H
#define VENDOR_MODEL_H

#include <zephyr/bluetooth/mesh.h>

#define BT_MESH_VENDOR_COMPANY_ID    0x0059  /* Nordic Semiconductor ASA */
#define BT_MESH_VENDOR_MODEL_ID_CLI  0x000A
#define BT_MESH_VENDOR_MODEL_ID_SRV  0x000B

#define BT_MESH_VENDOR_OP_LED_SET       BT_MESH_MODEL_OP_3(0x01, BT_MESH_VENDOR_COMPANY_ID)
#define BT_MESH_VENDOR_OP_LED_GET       BT_MESH_MODEL_OP_3(0x02, BT_MESH_VENDOR_COMPANY_ID)
#define BT_MESH_VENDOR_OP_LED_STATUS    BT_MESH_MODEL_OP_3(0x03, BT_MESH_VENDOR_COMPANY_ID)
#define BT_MESH_VENDOR_OP_BUTTON_PRESS  BT_MESH_MODEL_OP_3(0x04, BT_MESH_VENDOR_COMPANY_ID)

#define BT_MESH_VENDOR_MSG_MAXLEN_MESSAGE 32

#define LED_OFF 0x00
#define LED_ON  0x01

struct led_status {
    uint8_t led_index;
    uint8_t led_state;
};

struct button_press {
    uint8_t button_index;
    uint8_t button_state;
};

struct bt_mesh_vendor_model_srv;
struct bt_mesh_vendor_model_cli;

/* Server handlers */
struct vendor_model_srv_handlers {
    void (*const led_set)(struct bt_mesh_vendor_model_srv *srv,
                         struct bt_mesh_msg_ctx *ctx,
                         uint8_t led_index,
                         uint8_t led_state);
    void (*const led_get)(struct bt_mesh_vendor_model_srv *srv,
                         struct bt_mesh_msg_ctx *ctx,
                         uint8_t led_index);
    void (*const button_pressed)(struct bt_mesh_vendor_model_srv *srv,
                               struct bt_mesh_msg_ctx *ctx,
                               struct button_press *press);
};

/* Client handlers */
struct vendor_model_cli_handlers {
    void (*const led_status)(struct bt_mesh_vendor_model_cli *cli,
                           struct bt_mesh_msg_ctx *ctx,
                           struct led_status *status);
};

/* Server model context */
struct bt_mesh_vendor_model_srv {
    struct bt_mesh_model *model;
    const struct vendor_model_srv_handlers handlers;
    uint8_t led_states[4];
};

/* Client model context */
struct bt_mesh_vendor_model_cli {
    struct bt_mesh_model *model;
    const struct vendor_model_cli_handlers handlers;
};

/* Server API */
int bt_mesh_vendor_model_srv_led_status_send(struct bt_mesh_vendor_model_srv *srv,
                                          struct bt_mesh_msg_ctx *ctx,
                                          struct led_status *status);

/* Client API */
int bt_mesh_vendor_model_cli_led_set(struct bt_mesh_vendor_model_cli *cli,
                                   uint8_t led_index,
                                   uint8_t led_state);
int bt_mesh_vendor_model_cli_led_get(struct bt_mesh_vendor_model_cli *cli,
                                   uint8_t led_index);
int bt_mesh_vendor_model_cli_button_press(struct bt_mesh_vendor_model_cli *cli,
                                        struct button_press *press);

/* Model Definitions */
#define BT_MESH_VENDOR_MODEL_SRV_DEFINE(_name, _handlers) \
    static struct bt_mesh_vendor_model_srv _name = { \
        .handlers = _handlers, \
    }

#define BT_MESH_VENDOR_MODEL_CLI_DEFINE(_name, _handlers) \
    static struct bt_mesh_vendor_model_cli _name = { \
        .handlers = _handlers, \
    }

#define BT_MESH_VND_MODEL(_company, _id, _model, _pub) \
    BT_MESH_MODEL_VND_CB(_company, _id, _model.handlers.op, _pub, &_model, NULL, NULL)

#endif /* VENDOR_MODEL_H */
```

## src/vendor_model.c
```c
#include <zephyr/bluetooth/mesh.h>
#include <zephyr/sys/util.h>
#include "vendor_model.h"

/* Message handlers */
static int handle_led_status(const struct bt_mesh_model *model,
                           struct bt_mesh_msg_ctx *ctx,
                           struct net_buf_simple *buf)
{
    if (!model->user_data) {
        return -EINVAL;
    }
    
    struct bt_mesh_vendor_model_cli *cli = model->user_data;
    struct led_status status;

    if (!cli->handlers.led_status) {
        return -EINVAL;
    }

    status.led_index = net_buf_simple_pull_u8(buf);
    status.led_state = net_buf_simple_pull_u8(buf);

    cli->handlers.led_status(cli, ctx, &status);
    return 0;
}

/* Operation arrays for the models */
const struct bt_mesh_model_op vendor_cli_op[] = {
    { BT_MESH_VENDOR_OP_LED_STATUS, 2, handle_led_status },
    BT_MESH_MODEL_OP_END,
};

/* Client API Implementation */
int bt_mesh_vendor_model_cli_led_set(struct bt_mesh_vendor_model_cli *cli,
                                   uint8_t led_index,
                                   uint8_t led_state)
{
    if (!cli || !cli->model) {
        return -EINVAL;
    }

    BT_MESH_MODEL_BUF_DEFINE(msg, BT_MESH_VENDOR_OP_LED_SET,
                            BT_MESH_VENDOR_MSG_MAXLEN_MESSAGE);
    
    bt_mesh_model_msg_init(&msg, BT_MESH_VENDOR_OP_LED_SET);
    net_buf_simple_add_u8(&msg, led_index);
    net_buf_simple_add_u8(&msg, led_state);

    struct bt_mesh_msg_ctx ctx = {
        .addr = BT_MESH_ADDR_ALL_NODES,
        .app_idx = cli->model->keys[0],
        .send_ttl = BT_MESH_TTL_DEFAULT,
    };

    return bt_mesh_model_send(cli->model, &ctx, &msg, NULL, NULL);
}

int bt_mesh_vendor_model_cli_led_get(struct bt_mesh_vendor_model_cli *cli,
                                   uint8_t led_index)
{
    if (!cli || !cli->model) {
        return -EINVAL;
    }

    BT_MESH_MODEL_BUF_DEFINE(msg, BT_MESH_VENDOR_OP_LED_GET,
                            BT_MESH_VENDOR_MSG_MAXLEN_MESSAGE);
    
    bt_mesh_model_msg_init(&msg, BT_MESH_VENDOR_OP_LED_GET);
    net_buf_simple_add_u8(&msg, led_index);

    struct bt_mesh_msg_ctx ctx = {
        .addr = BT_MESH_ADDR_ALL_NODES,
        .app_idx = cli->model->keys[0],
        .send_ttl = BT_MESH_TTL_DEFAULT,
    };

    return bt_mesh_model_send(cli->model, &ctx, &msg, NULL, NULL);
}

int bt_mesh_vendor_model_cli_button_press(struct bt_mesh_vendor_model_cli *cli,
                                        struct button_press *press)
{
    if (!cli || !cli->model || !press) {
        return -EINVAL;
    }

    BT_MESH_MODEL_BUF_DEFINE(msg, BT_MESH_VENDOR_OP_BUTTON_PRESS,
                            BT_MESH_VENDOR_MSG_MAXLEN_MESSAGE);
    
    bt_mesh_model_msg_init(&msg, BT_MESH_VENDOR_OP_BUTTON_PRESS);
    net_buf_simple_add_u8(&msg, press->button_index);
    net_buf_simple_add_u8(&msg, press->button_state);

    struct bt_mesh_msg_ctx ctx = {
        .addr = BT_MESH_ADDR_ALL_NODES,
        .app_idx = cli->model->keys[0],
        .send_ttl = BT_MESH_TTL_DEFAULT,
    };

    return bt_mesh_model_send(cli->model, &ctx, &msg, NULL, NULL);
}
```
