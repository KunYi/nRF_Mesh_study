## CMakeLists.txt
```
# SPDX-License-Identifier: Apache-2.0

cmake_minimum_required(VERSION 3.20.0)

find_package(Zephyr REQUIRED HINTS $ENV{ZEPHYR_BASE})
project(mesh_light_server)

target_include_directories(app PRIVATE
  ${CMAKE_CURRENT_SOURCE_DIR}/include
)

target_sources(app PRIVATE
  src/main.c
  src/vendor_model.c
)
```

## prj.conf
```kconfig
# Enable Bluetooth
CONFIG_BT=y
CONFIG_BT_PERIPHERAL=y
CONFIG_BT_OBSERVER=y
CONFIG_BT_BROADCASTER=y
CONFIG_BT_CTLR=y

# Enable Bluetooth Mesh
CONFIG_BT_MESH=y
CONFIG_BT_MESH_RELAY=y
CONFIG_BT_MESH_FRIEND=y
CONFIG_BT_MESH_LOW_POWER=n
CONFIG_BT_MESH_PB_GATT=y
CONFIG_BT_MESH_PB_ADV=y

# Enable GATT proxy feature
CONFIG_BT_MESH_GATT_PROXY=y

# Mesh model configuration
CONFIG_BT_MESH_MODEL_GROUP_COUNT=3
CONFIG_BT_MESH_MODEL_KEY_COUNT=2
CONFIG_BT_MESH_MODEL_EXTENSIONS=y
CONFIG_BT_MESH_CDB=y

# Enable settings for storing mesh data
CONFIG_SETTINGS=y
CONFIG_BT_SETTINGS=y
CONFIG_FLASH=y
CONFIG_FLASH_MAP=y
CONFIG_NVS=y
CONFIG_SETTINGS_NVS=y

# Device Management
CONFIG_HWINFO=y
CONFIG_DK_LIBRARY=y

# Enable GPIO
CONFIG_GPIO=y

# Enable logging
CONFIG_LOG=y
CONFIG_LOG_DEFAULT_LEVEL=3
CONFIG_LOG_BACKEND_RTT=y
CONFIG_LOG_BACKEND_UART=y
CONFIG_USE_SEGGER_RTT=y

# Bluetooth debug logs
# CONFIG_BT_DEBUG_LOG=y
# CONFIG_BT_DEBUG=y
```

## src/main.c
```c
#include <zephyr/bluetooth/bluetooth.h>
#include <zephyr/bluetooth/mesh.h>
#include <dk_buttons_and_leds.h>
#include "vendor_model.h"
#include "device_config.h"

#define LED_MSG "LED state changed\n"

static void led_set_handler(struct bt_mesh_vendor_model_srv *srv,
                          struct bt_mesh_msg_ctx *ctx,
                          uint8_t led_index,
                          uint8_t led_state)
{
    if (led_index >= 4) {
        return;
    }

    /* Set the physical LED state */
    dk_set_led(led_index, led_state == LED_ON);
    
    /* Store state */
    srv->led_states[led_index] = led_state;
    
    /* Send status back */
    struct led_status status = {
        .led_index = led_index,
        .led_state = led_state
    };
    bt_mesh_vendor_model_srv_led_status_send(srv, ctx, &status);

    printk("LED %d set to %s\n", led_index, led_state == LED_ON ? "ON" : "OFF");
}

static void led_get_handler(struct bt_mesh_vendor_model_srv *srv,
                          struct bt_mesh_msg_ctx *ctx,
                          uint8_t led_index)
{
    if (led_index >= 4) {
        return;
    }

    struct led_status status = {
        .led_index = led_index,
        .led_state = srv->led_states[led_index]
    };
    bt_mesh_vendor_model_srv_led_status_send(srv, ctx, &status);

    printk("LED %d state requested\n", led_index);
}

static void button_handler(struct bt_mesh_vendor_model_srv *srv,
                         struct bt_mesh_msg_ctx *ctx,
                         struct button_press *press)
{
    printk("Button %d %s\n", 
           press->button_index,
           press->button_state == BUTTON_PRESSED ? "pressed" : "released");
}

/* Define server handlers */
static const struct bt_mesh_vendor_model_srv_handlers srv_handlers = {
    .led_set = led_set_handler,
    .led_get = led_get_handler,
    .button_pressed = button_handler,
};

/* Define server model */
BT_MESH_VENDOR_MODEL_SRV_DEFINE(vendor_server, srv_handlers);

/* Health Server */
struct bt_mesh_health_srv_cb health_srv_cb = {
    .attn_on = NULL,
    .attn_off = NULL,
};

BT_MESH_HEALTH_PUB_DEFINE(health_pub, 0);
struct bt_mesh_health_srv health_srv = {
    .cb = &health_srv_cb,
};

/* Node composition */
static struct bt_mesh_model models[] = {
    BT_MESH_MODEL_CFG_SRV,
    BT_MESH_MODEL_HEALTH_SRV(&health_srv, &health_pub),
    BT_MESH_VND_MODEL(BT_MESH_VENDOR_COMPANY_ID,
                      BT_MESH_VENDOR_MODEL_ID_SRV,
                      vendor_srv_op,
                      NULL,
                      &vendor_server)
};

static struct bt_mesh_elem elements[] = {
    BT_MESH_ELEM(0, models, BT_MESH_MODEL_NONE),
};

static const struct bt_mesh_comp comp = {
    .cid = BT_MESH_VENDOR_COMPANY_ID,
    .elem = elements,
    .elem_count = ARRAY_SIZE(elements),
};

/* Provisioning callbacks */
static void prov_complete(uint16_t net_idx, uint16_t addr)
{
    printk("Provisioning completed. Net idx 0x%04x, addr 0x%04x\n", net_idx, addr);
}

static void prov_reset(void)
{
    bt_mesh_prov_enable(BT_MESH_PROV_ADV | BT_MESH_PROV_GATT);
}

const struct bt_mesh_prov prov = {
    .uuid = dev_uuid,
    .output_size = 0,
    .output_actions = 0,
    .output_number = 0,
    .complete = prov_complete,
    .reset = prov_reset,
};

static void bt_ready(int err)
{
    if (err) {
        printk("Bluetooth init failed (err %d)\n", err);
        return;
    }

    printk("Bluetooth initialized\n");

    err = bt_mesh_init(&prov, &comp);
    if (err) {
        printk("Mesh initialization failed (err %d)\n", err);
        return;
    }

    printk("Mesh initialized\n");
}

void main(void)
{
    int err;

    printk("Initializing Light Server...\n");

    /* Initialize LEDs */
    err = dk_leds_init();
    if (err) {
        printk("LEDs init failed (err %d)\n", err);
        return;
    }

    /* Initialize Bluetooth */
    err = bt_enable(bt_ready);
    if (err) {
        printk("Bluetooth init failed (err %d)\n", err);
        return;
    }

    /* Enable provisioning */
    bt_mesh_prov_enable(BT_MESH_PROV_ADV | BT_MESH_PROV_GATT);

    printk("Light server initialized\n");
}
```

## include/device_config.h
```c
#ifndef DEVICE_CONFIG_H
#define DEVICE_CONFIG_H

#include <zephyr/bluetooth/mesh.h>

/* Device UUID for provisioning */
static uint8_t dev_uuid[16] = { 0xdd, 0xdd };

/* Health Server */
extern struct bt_mesh_health_srv health_srv;
extern struct bt_mesh_health_srv_cb health_srv_cb;
extern struct bt_mesh_model_pub health_pub;

/* Provisioning */
extern const struct bt_mesh_prov prov;

/* Vendor Model */
extern const struct bt_mesh_model_op vendor_srv_op[];
extern struct bt_mesh_vendor_model_srv vendor_server;

#endif /* DEVICE_CONFIG_H */
```

## include/vendor_model.h
```c
#ifndef VENDOR_MODEL_H__
#define VENDOR_MODEL_H__

#include <zephyr/bluetooth/mesh.h>

/* Company ID and Model IDs */
#define BT_MESH_VENDOR_COMPANY_ID    0x0059 /* Nordic Semiconductor ASA */
#define BT_MESH_VENDOR_MODEL_ID_SRV  0x0000
#define BT_MESH_VENDOR_MODEL_ID_CLI  0x0001

/* Operation codes for messages */
#define BT_MESH_VENDOR_OP_LED_SET     BT_MESH_MODEL_OP_3(0x00, BT_MESH_VENDOR_COMPANY_ID)
#define BT_MESH_VENDOR_OP_LED_GET     BT_MESH_MODEL_OP_3(0x01, BT_MESH_VENDOR_COMPANY_ID)
#define BT_MESH_VENDOR_OP_LED_STATUS  BT_MESH_MODEL_OP_3(0x02, BT_MESH_VENDOR_COMPANY_ID)
#define BT_MESH_VENDOR_OP_BUTTON_PRESS BT_MESH_MODEL_OP_3(0x03, BT_MESH_VENDOR_COMPANY_ID)

/* Maximum message length */
#define BT_MESH_VENDOR_MSG_MAXLEN_MESSAGE 4

/* LED states */
#define LED_OFF 0x00
#define LED_ON  0x01

/* Button states */
#define BUTTON_PRESSED  0x01
#define BUTTON_RELEASED 0x00

/* Message structures */
struct led_status {
    uint8_t led_index;
    uint8_t led_state;
};

struct button_press {
    uint8_t button_index;
    uint8_t button_state;
};

/* Forward declarations */
struct bt_mesh_vendor_model_cli;
struct bt_mesh_vendor_model_srv;

/* Operation arrays for the models */
extern const struct bt_mesh_model_op vendor_srv_op[];
extern const struct bt_mesh_model_op vendor_cli_op[];

/* Vendor Model Client API */
struct bt_mesh_vendor_model_cli_handlers {
    void (*led_status)(struct bt_mesh_vendor_model_cli *cli,
                      struct bt_mesh_msg_ctx *ctx,
                      struct led_status *status);
};

struct bt_mesh_vendor_model_cli {
    struct bt_mesh_model *model;
    struct bt_mesh_vendor_model_cli_handlers handlers;
};

/* Vendor Model Server API */
struct bt_mesh_vendor_model_srv_handlers {
    void (*led_set)(struct bt_mesh_vendor_model_srv *srv,
                   struct bt_mesh_msg_ctx *ctx,
                   uint8_t led_index,
                   uint8_t led_state);
    void (*led_get)(struct bt_mesh_vendor_model_srv *srv,
                   struct bt_mesh_msg_ctx *ctx,
                   uint8_t led_index);
    void (*button_pressed)(struct bt_mesh_vendor_model_srv *srv,
                          struct bt_mesh_msg_ctx *ctx,
                          struct button_press *press);
};

struct bt_mesh_vendor_model_srv {
    struct bt_mesh_model *model;
    struct bt_mesh_vendor_model_srv_handlers handlers;
    uint8_t led_states[4];  /* State storage for 4 LEDs */
};

/* Helper macros */
#define BT_MESH_VENDOR_MODEL_CLI_DEFINE(_name, _handlers) \
    static struct bt_mesh_vendor_model_cli _name = { \
        .handlers = _handlers \
    }

#define BT_MESH_VENDOR_MODEL_SRV_DEFINE(_name, _handlers) \
    static struct bt_mesh_vendor_model_srv _name = { \
        .handlers = _handlers \
    }

/* Client API functions */
int bt_mesh_vendor_model_cli_led_set(struct bt_mesh_vendor_model_cli *cli,
                                   uint8_t led_index,
                                   uint8_t led_state);
int bt_mesh_vendor_model_cli_led_get(struct bt_mesh_vendor_model_cli *cli,
                                   uint8_t led_index);
int bt_mesh_vendor_model_cli_button_press(struct bt_mesh_vendor_model_cli *cli,
                                        struct button_press *press);

/* Server API functions */
int bt_mesh_vendor_model_srv_led_status_send(struct bt_mesh_vendor_model_srv *srv,
                                          struct bt_mesh_msg_ctx *ctx,
                                          struct led_status *status);

#endif /* VENDOR_MODEL_H__ */
```

## src/vendor_model.c
```c
#include <zephyr/bluetooth/mesh.h>
#include "vendor_model.h"

/* Forward declarations of message handlers */
static int handle_led_set(const struct bt_mesh_model *model,
                        struct bt_mesh_msg_ctx *ctx,
                        struct net_buf_simple *buf);
static int handle_led_get(const struct bt_mesh_model *model,
                        struct bt_mesh_msg_ctx *ctx,
                        struct net_buf_simple *buf);
static int handle_led_status(const struct bt_mesh_model *model,
                           struct bt_mesh_msg_ctx *ctx,
                           struct net_buf_simple *buf);
static int handle_button_press(const struct bt_mesh_model *model,
                             struct bt_mesh_msg_ctx *ctx,
                             struct net_buf_simple *buf);

/* Operation arrays for the models */
const struct bt_mesh_model_op vendor_srv_op[] = {
    { BT_MESH_VENDOR_OP_LED_SET, 2, handle_led_set },
    { BT_MESH_VENDOR_OP_LED_GET, 1, handle_led_get },
    { BT_MESH_VENDOR_OP_BUTTON_PRESS, 2, handle_button_press },
    BT_MESH_MODEL_OP_END,
};

const struct bt_mesh_model_op vendor_cli_op[] = {
    { BT_MESH_VENDOR_OP_LED_STATUS, 2, handle_led_status },
    BT_MESH_MODEL_OP_END,
};

/* Message handlers */
static int handle_led_set(const struct bt_mesh_model *model,
                        struct bt_mesh_msg_ctx *ctx,
                        struct net_buf_simple *buf)
{
    struct bt_mesh_vendor_model_srv *srv = model->user_data;
    uint8_t led_index = net_buf_simple_pull_u8(buf);
    uint8_t led_state = net_buf_simple_pull_u8(buf);

    if (srv->handlers.led_set) {
        srv->handlers.led_set(srv, ctx, led_index, led_state);
    }

    /* Store the LED state */
    if (led_index < 4) {
        srv->led_states[led_index] = led_state;
    }

    /* Send status message back */
    struct led_status status = {
        .led_index = led_index,
        .led_state = led_state
    };
    bt_mesh_vendor_model_srv_led_status_send(srv, ctx, &status);
    
    return 0;
}

static int handle_led_get(const struct bt_mesh_model *model,
                        struct bt_mesh_msg_ctx *ctx,
                        struct net_buf_simple *buf)
{
    struct bt_mesh_vendor_model_srv *srv = model->user_data;
    uint8_t led_index = net_buf_simple_pull_u8(buf);

    if (srv->handlers.led_get) {
        srv->handlers.led_get(srv, ctx, led_index);
    }

    /* Send status message back */
    struct led_status status = {
        .led_index = led_index,
        .led_state = (led_index < 4) ? srv->led_states[led_index] : LED_OFF
    };
    bt_mesh_vendor_model_srv_led_status_send(srv, ctx, &status);
    
    return 0;
}

static int handle_led_status(const struct bt_mesh_model *model,
                           struct bt_mesh_msg_ctx *ctx,
                           struct net_buf_simple *buf)
{
    struct bt_mesh_vendor_model_cli *cli = model->user_data;
    struct led_status status;

    status.led_index = net_buf_simple_pull_u8(buf);
    status.led_state = net_buf_simple_pull_u8(buf);

    if (cli->handlers.led_status) {
        cli->handlers.led_status(cli, ctx, &status);
    }
    
    return 0;
}

static int handle_button_press(const struct bt_mesh_model *model,
                            struct bt_mesh_msg_ctx *ctx,
                            struct net_buf_simple *buf)
{
    struct bt_mesh_vendor_model_srv *srv = model->user_data;
    struct button_press press;

    press.button_index = net_buf_simple_pull_u8(buf);
    press.button_state = net_buf_simple_pull_u8(buf);

    if (srv->handlers.button_pressed) {
        srv->handlers.button_pressed(srv, ctx, &press);
    }
    
    return 0;
}

/* Client API Implementation */
int bt_mesh_vendor_model_cli_led_set(struct bt_mesh_vendor_model_cli *cli,
                                   uint8_t led_index,
                                   uint8_t led_state)
{
    struct net_buf_simple *msg = NET_BUF_SIMPLE(BT_MESH_VENDOR_MSG_MAXLEN_MESSAGE);

    net_buf_simple_init(msg, 0);
    net_buf_simple_add_u8(msg, led_index);
    net_buf_simple_add_u8(msg, led_state);

    struct bt_mesh_msg_ctx ctx = {
        .addr = 0xC000,  /* Group address */
        .app_idx = 0,    /* Use first application key */
        .send_ttl = BT_MESH_TTL_DEFAULT,
    };

    return bt_mesh_model_send(cli->model, &ctx, msg, NULL, NULL);
}

int bt_mesh_vendor_model_cli_led_get(struct bt_mesh_vendor_model_cli *cli,
                                   uint8_t led_index)
{
    struct net_buf_simple *msg = NET_BUF_SIMPLE(BT_MESH_VENDOR_MSG_MAXLEN_MESSAGE);

    net_buf_simple_init(msg, 0);
    net_buf_simple_add_u8(msg, led_index);

    struct bt_mesh_msg_ctx ctx = {
        .addr = 0xC000,  /* Group address */
        .app_idx = 0,    /* Use first application key */
        .send_ttl = BT_MESH_TTL_DEFAULT,
    };

    return bt_mesh_model_send(cli->model, &ctx, msg, NULL, NULL);
}

int bt_mesh_vendor_model_cli_button_press(struct bt_mesh_vendor_model_cli *cli,
                                        struct button_press *press)
{
    struct net_buf_simple *msg = NET_BUF_SIMPLE(BT_MESH_VENDOR_MSG_MAXLEN_MESSAGE);

    net_buf_simple_init(msg, 0);
    net_buf_simple_add_u8(msg, press->button_index);
    net_buf_simple_add_u8(msg, press->button_state);

    struct bt_mesh_msg_ctx ctx = {
        .addr = 0xC000,  /* Group address */
        .app_idx = 0,    /* Use first application key */
        .send_ttl = BT_MESH_TTL_DEFAULT,
    };

    return bt_mesh_model_send(cli->model, &ctx, msg, NULL, NULL);
}

/* Server API Implementation */
int bt_mesh_vendor_model_srv_led_status_send(struct bt_mesh_vendor_model_srv *srv,
                                          struct bt_mesh_msg_ctx *ctx,
                                          struct led_status *status)
{
    struct net_buf_simple *msg = NET_BUF_SIMPLE(BT_MESH_VENDOR_MSG_MAXLEN_MESSAGE);

    net_buf_simple_init(msg, 0);
    net_buf_simple_add_u8(msg, status->led_index);
    net_buf_simple_add_u8(msg, status->led_state);

    return bt_mesh_model_send(srv->model, ctx, msg, NULL, NULL);
}
```
